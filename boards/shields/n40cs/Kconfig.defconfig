## boards/shields/n40cs/Kconfig.defconfig
```kconfig
if SHIELD_N40CS_LEFT

config ZMK_KEYBOARD_NAME
    default "N40CS"

config ZMK_SPLIT_ROLE_CENTRAL
    default y

config ZMK_STUDIO
    default y

endif # SHIELD_N40CS_LEFT

if SHIELD_N40CS_LEFT || SHIELD_N40CS_RIGHT

config ZMK_SPLIT
    default y

config ZMK_SLEEP
    default y

config ZMK_BLE_EXPERIMENTAL_CONN
    default y

endif # SHIELD_N40CS_LEFT || SHIELD_N40CS_RIGHT
```

## boards/shields/n40cs/Kconfig.shield
```kconfig
config SHIELD_N40CS_LEFT
    def_bool $(shields_list_contains,n40cs_left)

config SHIELD_N40CS_RIGHT
    def_bool $(shields_list_contains,n40cs_right)
```
